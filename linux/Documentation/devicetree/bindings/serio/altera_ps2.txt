## linux/Documentation/devicetree/bindings/serio/altera_ps2.txt
```
https://powcoder.com
代写代考加微信 powcoder
Assignment Project Exam Help
Add WeChat powcoder
Altera UP PS/2 controller

Required properties:
- compatible : should be "ALTR,ps2-1.0". <DEPRECATED>
- compatible : should be "altr,ps2-1.0".
```

## linux/Documentation/devicetree/bindings/sound/adi,ssm2305.txt
```
https://powcoder.com
代写代考加微信 powcoder
Assignment Project Exam Help
Add WeChat powcoder
Analog Devices SSM2305 Speaker Amplifier
========================================

Required properties:
  - compatible : "adi,ssm2305"
  - shutdown-gpios : The gpio connected to the shutdown pin.
                     The gpio signal is ACTIVE_LOW.

Example:

ssm2305: analog-amplifier {
	compatible = "adi,ssm2305";
	shutdown-gpios = <&gpio3 20 GPIO_ACTIVE_LOW>;
};
```

## linux/Documentation/devicetree/bindings/sound/ak4554.txt
```
https://powcoder.com
代写代考加微信 powcoder
Assignment Project Exam Help
Add WeChat powcoder
AK4554 ADC/DAC

Required properties:

  - compatible : "asahi-kasei,ak4554"

Example:

ak4554-adc-dac {
	compatible = "asahi-kasei,ak4554";
};
```

## linux/Documentation/devicetree/bindings/sound/bt-sco.txt
```
https://powcoder.com
代写代考加微信 powcoder
Assignment Project Exam Help
Add WeChat powcoder
Bluetooth-SCO audio CODEC

This device support generic Bluetooth SCO link.

Required properties:

  - compatible : "delta,dfbmcs320" or "linux,bt-sco"

Example:

codec: bt_sco {
	compatible = "delta,dfbmcs320";
};
```

## linux/Documentation/devicetree/bindings/sound/everest,es7134.txt
```
https://powcoder.com
代写代考加微信 powcoder
Assignment Project Exam Help
Add WeChat powcoder
ES7134 i2s DA converter

Required properties:
- compatible : "everest,es7134" or
               "everest,es7144" or
	       "everest,es7154"
- VDD-supply : regulator phandle for the VDD supply
- PVDD-supply: regulator phandle for the PVDD supply for the es7154

Example:

i2s_codec: external-codec {
	compatible = "everest,es7134";
	VDD-supply = <&vcc_5v>;
};
```

## linux/Documentation/devicetree/bindings/sound/mt6797-mt6351.txt
```
https://powcoder.com
代写代考加微信 powcoder
Assignment Project Exam Help
Add WeChat powcoder
MT6797 with MT6351 CODEC

Required properties:
- compatible: "mediatek,mt6797-mt6351-sound"
- mediatek,platform: the phandle of MT6797 ASoC platform
- mediatek,audio-codec: the phandles of MT6351 codec

Example:

	sound {
		compatible = "mediatek,mt6797-mt6351-sound";
		mediatek,audio-codec = <&mt6351_snd>;
		mediatek,platform = <&afe>;
	};
```

## linux/Documentation/devicetree/bindings/sound/nau8540.txt
```
https://powcoder.com
代写代考加微信 powcoder
Assignment Project Exam Help
Add WeChat powcoder
NAU85L40 audio CODEC

This device supports I2C only.

Required properties:

  - compatible : "nuvoton,nau8540"

  - reg : the I2C address of the device.

Example:

codec: nau8540@1c {
       compatible = "nuvoton,nau8540";
       reg = <0x1c>;
};
```

## linux/Documentation/devicetree/bindings/sound/nau8822.txt
```
https://powcoder.com
代写代考加微信 powcoder
Assignment Project Exam Help
Add WeChat powcoder
NAU8822 audio CODEC

This device supports I2C only.

Required properties:

  - compatible : "nuvoton,nau8822"

  - reg : the I2C address of the device.

Example:

codec: nau8822@1a {
	compatible = "nuvoton,nau8822";
	reg = <0x1a>;
};
```

## linux/Documentation/devicetree/bindings/sound/nvidia,tegra20-das.txt
```
https://powcoder.com
代写代考加微信 powcoder
Assignment Project Exam Help
Add WeChat powcoder
NVIDIA Tegra 20 DAS (Digital Audio Switch) controller

Required properties:
- compatible : "nvidia,tegra20-das"
- reg : Should contain DAS registers location and length

Example:

das@70000c00 {
	compatible = "nvidia,tegra20-das";
	reg = <0x70000c00 0x80>;
};
```

## linux/Documentation/devicetree/bindings/sound/rockchip-rt5645.txt
```
https://powcoder.com
代写代考加微信 powcoder
Assignment Project Exam Help
Add WeChat powcoder
ROCKCHIP with RT5645/RT5650 CODECS

Required properties:
- compatible: "rockchip,rockchip-audio-rt5645"
- rockchip,model: The user-visible name of this sound complex
- rockchip,i2s-controller: The phandle of the Rockchip I2S controller that's
  connected to the CODEC
- rockchip,audio-codec: The phandle of the RT5645/RT5650 audio codec

Example:

sound {
	compatible = "rockchip,rockchip-audio-rt5645";
	rockchip,model = "ROCKCHIP-I2S";
	rockchip,i2s-controller = <&i2s>;
	rockchip,audio-codec = <&rt5645>;
};
```

## linux/Documentation/devicetree/bindings/sound/sirf-audio-codec.txt
```
https://powcoder.com
代写代考加微信 powcoder
Assignment Project Exam Help
Add WeChat powcoder
SiRF internal audio CODEC

Required properties:

  - compatible : "sirf,atlas6-audio-codec" or "sirf,prima2-audio-codec"

  - reg : the register address of the device.

  - clocks: the clock of SiRF internal audio codec

Example:

audiocodec: audiocodec@b0040000 {
	compatible = "sirf,atlas6-audio-codec";
	reg = <0xb0040000 0x10000>;
	clocks = <&clks 27>;
};
```

## linux/Documentation/devicetree/bindings/sound/spdif-transmitter.txt
```
https://powcoder.com
代写代考加微信 powcoder
Assignment Project Exam Help
Add WeChat powcoder
Device-Tree bindings for dummy spdif transmitter

Required properties:
	- compatible: should be "linux,spdif-dit".

Example node:

	codec: spdif-transmitter {
		compatible = "linux,spdif-dit";
	};
```

## linux/Documentation/devicetree/bindings/sound/ti,ads117x.txt
```
https://powcoder.com
代写代考加微信 powcoder
Assignment Project Exam Help
Add WeChat powcoder
Texas Intstruments ADS117x ADC

Required properties:

  - compatible : "ti,ads1174" or "ti,ads1178"

Example:

ads1178 {
	compatible = "ti,ads1178";
};
```

## linux/Documentation/devicetree/bindings/sound/tscs454.txt
```
https://powcoder.com
代写代考加微信 powcoder
Assignment Project Exam Help
Add WeChat powcoder
TSCS454 Audio CODEC

Required Properties:

	- compatible :	"tempo,tscs454"

	- reg : 	<0x69>

	- clock-names:	Must one of  the following "xtal", "mclk1", "mclk2"

	- clocks:	phandle of the clock that provides the codec sysclk

	Note: If clock is not provided then bit clock is assumed

Example:

redwood: codec@69 {
	#sound-dai-cells = <1>;
	compatible = "tempo,tscs454";
	reg = <0x69>;
	clock-names = "mclk1";
	clocks = <&audio_mclk>;
};
```

## linux/Documentation/devicetree/bindings/sound/wm8782.txt
```
https://powcoder.com
代写代考加微信 powcoder
Assignment Project Exam Help
Add WeChat powcoder
WM8782 stereo ADC

This device does not have any control interface or reset pins.

Required properties:

 - compatible  : "wlf,wm8782"
 - Vdda-supply : phandle to a regulator for the analog power supply (2.7V - 5.5V)
 - Vdd-supply  : phandle to a regulator for the digital power supply (2.7V - 3.6V)

Example:

wm8782: stereo-adc {
	compatible = "wlf,wm8782";
	Vdda-supply = <&vdda_supply>;
	Vdd-supply = <&vdd_supply>;
};
```

## linux/Documentation/devicetree/bindings/spi/spi_altera.txt
```
https://powcoder.com
代写代考加微信 powcoder
Assignment Project Exam Help
Add WeChat powcoder
Altera SPI

Required properties:
- compatible : should be "ALTR,spi-1.0". <DEPRECATED>
- compatible : should be "altr,spi-1.0".
```

## linux/Documentation/devicetree/bindings/thermal/kirkwood-thermal.txt
```
https://powcoder.com
代写代考加微信 powcoder
Assignment Project Exam Help
Add WeChat powcoder
* Kirkwood Thermal

This version is for Kirkwood 88F8262 & 88F6283 SoCs. Other kirkwoods
don't contain a thermal sensor.

Required properties:
- compatible : "marvell,kirkwood-thermal"
- reg : Address range of the thermal registers

Example:

	thermal@10078 {
		compatible = "marvell,kirkwood-thermal";
		reg = <0x10078 0x4>;
	};
```

## linux/Documentation/devicetree/bindings/timer/snps,archs-gfrc.txt
```
https://powcoder.com
代写代考加微信 powcoder
Assignment Project Exam Help
Add WeChat powcoder
Synopsys ARC Free Running 64-bit Global Timer for ARC HS CPUs
- clocksource provider for SMP SoC

Required properties:

- compatible : should be "snps,archs-gfrc"
- clocks     : phandle to the source clock

Example:

	gfrc {
		compatible = "snps,archs-gfrc";
		clocks = <&core_clk>;
	};
```

## linux/Documentation/devicetree/bindings/timer/via,vt8500-timer.txt
```
https://powcoder.com
代写代考加微信 powcoder
Assignment Project Exam Help
Add WeChat powcoder
VIA/Wondermedia VT8500 Timer
-----------------------------------------------------

Required properties:
- compatible : "via,vt8500-timer"
- reg : Should contain 1 register ranges(address and length)
- interrupts : interrupt for the timer

Example:

	timer@d8130100 {
		compatible = "via,vt8500-timer";
		reg = <0xd8130100 0x28>;
		interrupts = <36>;
	};
```

## linux/Documentation/devicetree/bindings/watchdog/moxa,moxart-watchdog.txt
```
https://powcoder.com
代写代考加微信 powcoder
Assignment Project Exam Help
Add WeChat powcoder
MOXA ART Watchdog timer

Required properties:

- compatible : Must be "moxa,moxart-watchdog"
- reg : Should contain registers location and length
- clocks : Should contain phandle for the clock that drives the counter

Example:

	watchdog: watchdog@98500000 {
		compatible = "moxa,moxart-watchdog";
		reg = <0x98500000 0x10>;
		clocks = <&coreclk>;
	};
```

## linux/Documentation/devicetree/bindings/watchdog/qca-ar7130-wdt.txt
```
https://powcoder.com
代写代考加微信 powcoder
Assignment Project Exam Help
Add WeChat powcoder
* Qualcomm Atheros AR7130 Watchdog Timer (WDT) Controller

Required properties:
- compatible: must be "qca,ar7130-wdt"
- reg: physical base address of the controller and length of memory mapped
  region.

Example:

wdt@18060008 {
	compatible = "qca,ar9330-wdt", "qca,ar7130-wdt";
	reg = <0x18060008 0x8>;
};
```

## linux/Documentation/devicetree/bindings/watchdog/twl4030-wdt.txt
```
https://powcoder.com
代写代考加微信 powcoder
Assignment Project Exam Help
Add WeChat powcoder
Device tree bindings for twl4030-wdt driver (TWL4030 watchdog)

Required properties:
	compatible = "ti,twl4030-wdt";

Example:

watchdog {
	compatible = "ti,twl4030-wdt";
};
```

## linux/Documentation/devicetree/bindings/x86/timer.txt
```
https://powcoder.com
代写代考加微信 powcoder
Assignment Project Exam Help
Add WeChat powcoder
Timers
------

* High Precision Event Timer (HPET)
  Required property:
     compatible = "intel,ce4100-hpet";
```
