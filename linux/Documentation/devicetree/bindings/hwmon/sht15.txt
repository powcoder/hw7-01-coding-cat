## linux/Documentation/devicetree/bindings/hwmon/sht15.txt
```
https://powcoder.com
代写代考加微信 powcoder
Assignment Project Exam Help
Add WeChat powcoder
Sensirion SHT15 Humidity and Temperature Sensor

Required properties:

 - "compatible": must be "sensirion,sht15".
 - "data-gpios": GPIO connected to the data line.
 - "clk-gpios": GPIO connected to the clock line.
 - "vcc-supply": regulator that drives the VCC pin.

Example:

	sensor {
		pinctrl-names = "default";
		pinctrl-0 = <&pinctrl_sensor>;
		compatible = "sensirion,sht15";
		clk-gpios = <&gpio4 12 0>;
		data-gpios = <&gpio4 13 0>;
		vcc-supply = <&reg_sht15>;
	};
```

## linux/Documentation/devicetree/bindings/i2c/i2c-stu300.txt
```
https://powcoder.com
代写代考加微信 powcoder
Assignment Project Exam Help
Add WeChat powcoder
ST Microelectronics DDC I2C

Required properties :
- compatible : Must be "st,ddci2c"
- reg: physical base address of the controller and length of memory mapped
     region.
- interrupts: interrupt number to the cpu.
- #address-cells = <1>;
- #size-cells = <0>;

Optional properties:
- Child nodes conforming to i2c bus binding

Examples :
```

## linux/Documentation/devicetree/bindings/i2c/ibm,p8-occ-hwmon.txt
```
https://powcoder.com
代写代考加微信 powcoder
Assignment Project Exam Help
Add WeChat powcoder
Device-tree bindings for I2C-based On-Chip Controller hwmon device
------------------------------------------------------------------

Required properties:
 - compatible = "ibm,p8-occ-hwmon";
 - reg = <I2C address>;			: I2C bus address

Examples:

    i2c-bus@100 {
        #address-cells = <1>;
        #size-cells = <0>;
        clock-frequency = <100000>;
        < more properties >

        occ-hwmon@1 {
            compatible = "ibm,p8-occ-hwmon";
            reg = <0x50>;
        };

        occ-hwmon@2 {
            compatible = "ibm,p8-occ-hwmon";
            reg = <0x51>;
        };
    };
```

## linux/Documentation/devicetree/bindings/iio/accel/dmard06.txt
```
https://powcoder.com
代写代考加微信 powcoder
Assignment Project Exam Help
Add WeChat powcoder
Device tree bindings for Domintech DMARD05, DMARD06, DMARD07 accelerometers

Required properties:
 - compatible		: Should be "domintech,dmard05"
				 or "domintech,dmard06"
				 or "domintech,dmard07"
 - reg			: I2C address of the chip. Should be 0x1c

Example:
	&i2c1 {
		/* ... */

		accelerometer@1c {
			compatible = "domintech,dmard06";
			reg = <0x1c>;
		};

		/* ... */
	};
```

## linux/Documentation/devicetree/bindings/iio/chemical/bme680.txt
```
https://powcoder.com
代写代考加微信 powcoder
Assignment Project Exam Help
Add WeChat powcoder
Bosch Sensortec BME680 pressure/temperature/humidity/voc sensors

Required properties:
- compatible: must be "bosch,bme680"

Example:

bme680@76 {
          compatible = "bosch,bme680";
          reg = <0x76>;
};
```

## linux/Documentation/devicetree/bindings/iio/chemical/sensirion,sgp30.txt
```
https://powcoder.com
代写代考加微信 powcoder
Assignment Project Exam Help
Add WeChat powcoder
* Sensirion SGP30/SGPC3 multi-pixel Gas Sensor

Required properties:

  - compatible: must be one of
    "sensirion,sgp30"
    "sensirion,sgpc3"
  - reg: the I2C address of the sensor

Example:

gas@58 {
	compatible = "sensirion,sgp30";
	reg = <0x58>;
};
```

## linux/Documentation/devicetree/bindings/iio/humidity/hdc100x.txt
```
https://powcoder.com
代写代考加微信 powcoder
Assignment Project Exam Help
Add WeChat powcoder
* HDC100x temperature + humidity sensors

Required properties:
  - compatible: Should contain one of the following:
	ti,hdc1000
	ti,hdc1008
	ti,hdc1010
	ti,hdc1050
	ti,hdc1080
  - reg: i2c address of the sensor

Example:

hdc100x@40 {
	compatible = "ti,hdc1000";
	reg = <0x40>;
};
```

## linux/Documentation/devicetree/bindings/iio/light/renesas,isl29501.txt
```
https://powcoder.com
代写代考加微信 powcoder
Assignment Project Exam Help
Add WeChat powcoder
* ISL29501 Time-of-flight sensor.

Required properties:

  - compatible : should be "renesas,isl29501"
  - reg : the I2C address of the sensor

Example:

isl29501@57 {
	compatible = "renesas,isl29501";
	reg = <0x57>;
};
```

## linux/Documentation/devicetree/bindings/iio/magnetometer/mmc35240.txt
```
https://powcoder.com
代写代考加微信 powcoder
Assignment Project Exam Help
Add WeChat powcoder
* MEMSIC MMC35240 magnetometer sensor

Required properties:

  - compatible : should be "memsic,mmc35240"
  - reg : the I2C address of the magnetometer

Example:

mmc35240@30 {
        compatible = "memsic,mmc35240";
        reg = <0x30>;
};
```

## linux/Documentation/devicetree/bindings/iio/pressure/ms5611.txt
```
https://powcoder.com
代写代考加微信 powcoder
Assignment Project Exam Help
Add WeChat powcoder
MEAS ms5611 family pressure sensors

Pressure sensors from MEAS Switzerland with SPI and I2C bus interfaces.

Required properties:
- compatible: "meas,ms5611" or "meas,ms5607"
- reg: the I2C address or SPI chip select the device will respond to

Optional properties:
- vdd-supply: an optional regulator that needs to be on to provide VDD
  power to the sensor.

Example:

ms5607@77 {
	compatible = "meas,ms5607";
	reg = <0x77>;
	vdd-supply = <&ldo_3v3_gnss>;
};
```

## linux/Documentation/devicetree/bindings/input/fsl-mma8450.txt
```
https://powcoder.com
代写代考加微信 powcoder
Assignment Project Exam Help
Add WeChat powcoder
* Freescale MMA8450 3-Axis Accelerometer

Required properties:
- compatible : "fsl,mma8450".
- reg: the I2C address of MMA8450

Example:

accelerometer: mma8450@1c {
	compatible = "fsl,mma8450";
	reg = <0x1c>;
};
```

## linux/Documentation/devicetree/bindings/input/gpio-beeper.txt
```
https://powcoder.com
代写代考加微信 powcoder
Assignment Project Exam Help
Add WeChat powcoder
* GPIO beeper device tree bindings

Register a beeper connected to GPIO pin.

Required properties:
- compatible:	Should be "gpio-beeper".
- gpios:	From common gpio binding; gpio connection to beeper enable pin.

Example:
	beeper: beeper {
		compatible = "gpio-beeper";
		gpios = <&gpio3 23 GPIO_ACTIVE_HIGH>;
	};
```

## linux/Documentation/devicetree/bindings/interrupt-controller/ezchip,nps400-ic.txt
```
https://powcoder.com
代写代考加微信 powcoder
Assignment Project Exam Help
Add WeChat powcoder
EZchip NPS Interrupt Controller

Required properties:

- compatible : should be "ezchip,nps400-ic"
- interrupt-controller : Identifies the node as an interrupt controller
- #interrupt-cells : Specifies the number of cells needed to encode an
  interrupt source. The value shall be 1.


Example:

intc: interrupt-controller {
	compatible = "ezchip,nps400-ic";
	interrupt-controller;
	#interrupt-cells = <1>;
};
```

## linux/Documentation/devicetree/bindings/jailhouse.txt
```
https://powcoder.com
代写代考加微信 powcoder
Assignment Project Exam Help
Add WeChat powcoder
Jailhouse non-root cell device tree bindings
--------------------------------------------

When running in a non-root Jailhouse cell (partition), the device tree of this
platform shall have a top-level "hypervisor" node with the following
properties:

- compatible = "jailhouse,cell"
```

## linux/Documentation/devicetree/bindings/leds/backlight/88pm860x.txt
```
https://powcoder.com
代写代考加微信 powcoder
Assignment Project Exam Help
Add WeChat powcoder
88pm860x-backlight bindings

Optional properties:
  - marvell,88pm860x-iset: Current supplies on backlight device.
  - marvell,88pm860x-pwm: PWM frequency on backlight device.

Example:

	backlights {
		backlight-0 {
			marvell,88pm860x-iset = <4>;
			marvell,88pm860x-pwm = <3>;
		};
		backlight-2 {
		};
```

## linux/Documentation/devicetree/bindings/leds/backlight/max8925-backlight.txt
```
https://powcoder.com
代写代考加微信 powcoder
Assignment Project Exam Help
Add WeChat powcoder
88pm860x-backlight bindings

Optional properties:
  - maxim,max8925-dual-string: whether support dual string

Example:

	backlights {
		maxim,max8925-dual-string = <0>;
	};
```

## linux/Documentation/devicetree/bindings/media/i2c/ak7375.txt
```
https://powcoder.com
代写代考加微信 powcoder
Assignment Project Exam Help
Add WeChat powcoder
Asahi Kasei Microdevices AK7375 voice coil lens driver

AK7375 is a camera voice coil lens.

Mandatory properties:

- compatible: "asahi-kasei,ak7375"
- reg: I2C slave address
```

## linux/Documentation/devicetree/bindings/media/i2c/dongwoon,dw9714.txt
```
https://powcoder.com
代写代考加微信 powcoder
Assignment Project Exam Help
Add WeChat powcoder
Dongwoon Anatech DW9714 camera voice coil lens driver

DW9174 is a 10-bit DAC with current sink capability. It is intended
for driving voice coil lenses in camera modules.

Mandatory properties:

- compatible: "dongwoon,dw9714"
- reg: I²C slave address
```

## linux/Documentation/devicetree/bindings/media/i2c/dongwoon,dw9807-vcm.txt
```
https://powcoder.com
代写代考加微信 powcoder
Assignment Project Exam Help
Add WeChat powcoder
Dongwoon Anatech DW9807 voice coil lens driver

DW9807 is a 10-bit DAC with current sink capability. It is intended for
controlling voice coil lenses.

Mandatory properties:

- compatible: "dongwoon,dw9807-vcm"
- reg: I2C slave address
```

## linux/Documentation/devicetree/bindings/mips/ni.txt
```
https://powcoder.com
代写代考加微信 powcoder
Assignment Project Exam Help
Add WeChat powcoder
National Instruments MIPS platforms

required root node properties:
	- compatible: must be "ni,169445"

CPU Nodes
	- compatible: must be "mti,mips14KEc"
```

## linux/Documentation/devicetree/bindings/misc/fsl,dpaa2-console.txt
```
https://powcoder.com
代写代考加微信 powcoder
Assignment Project Exam Help
Add WeChat powcoder
DPAA2 console support

Required properties:

    - compatible
        Value type: <string>
        Definition: Must be "fsl,dpaa2-console".
    - reg
        Value type: <prop-encoded-array>
        Definition: A standard property.  Specifies the region where the MCFBA
                    (MC firmware base address) register can be found.
```

## linux/Documentation/devicetree/bindings/mtd/diskonchip.txt
```
https://powcoder.com
代写代考加微信 powcoder
Assignment Project Exam Help
Add WeChat powcoder
M-Systems and Sandisk DiskOnChip devices

M-System DiskOnChip G3
======================
The Sandisk (formerly M-Systems) docg3 is a nand device of 64M to 256MB.

Required properties:
 - compatible: should be "m-systems,diskonchip-g3"
 - reg: register base and size

Example:
	docg3: flash@0 {
		compatible = "m-systems,diskonchip-g3";
		reg = <0x0 0x2000>;
	};
```
