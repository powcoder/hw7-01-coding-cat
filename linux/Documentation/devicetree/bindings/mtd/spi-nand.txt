## linux/Documentation/devicetree/bindings/mtd/spi-nand.txt
```
https://powcoder.com
代写代考加微信 powcoder
Assignment Project Exam Help
Add WeChat powcoder
SPI NAND flash

Required properties:
- compatible: should be "spi-nand"
- reg: should encode the chip-select line used to access the NAND chip
```

## linux/Documentation/devicetree/bindings/net/bluetooth.txt
```
https://powcoder.com
代写代考加微信 powcoder
Assignment Project Exam Help
Add WeChat powcoder
The following properties are common to the Bluetooth controllers:

- local-bd-address: array of 6 bytes, specifies the BD address that was
  uniquely assigned to the Bluetooth device, formatted with least significant
  byte first (little-endian).
```

## linux/Documentation/devicetree/bindings/net/maxim,ds26522.txt
```
https://powcoder.com
代写代考加微信 powcoder
Assignment Project Exam Help
Add WeChat powcoder
* Maxim (Dallas) DS26522 Dual T1/E1/J1 Transceiver

Required properties:
- compatible: Should contain "maxim,ds26522".
- reg: SPI CS.
- spi-max-frequency: SPI clock.

Example:
	slic@1 {
		compatible = "maxim,ds26522";
		reg = <1>;
		spi-max-frequency = <2000000>; /* input clock */
	};
```

## linux/Documentation/devicetree/bindings/phy/brcm,kona-usb2-phy.txt
```
https://powcoder.com
代写代考加微信 powcoder
Assignment Project Exam Help
Add WeChat powcoder
BROADCOM KONA USB2 PHY

Required properties:
 - compatible: brcm,kona-usb2-phy
 - reg: offset and length of the PHY registers
 - #phy-cells: must be 0
Refer to phy/phy-bindings.txt for the generic PHY binding properties

Example:

	usbphy: usb-phy@3f130000 {
		compatible = "brcm,kona-usb2-phy";
		reg = <0x3f130000 0x28>;
		#phy-cells = <0>;
	};
```

## linux/Documentation/devicetree/bindings/power/reset/brcm,bcm21664-resetmgr.txt
```
https://powcoder.com
代写代考加微信 powcoder
Assignment Project Exam Help
Add WeChat powcoder
Broadcom Kona Family Reset Manager
----------------------------------

The reset manager is used on the Broadcom BCM21664 SoC.

Required properties:
  - compatible: brcm,bcm21664-resetmgr
  - reg: memory address & range

Example:
	brcm,resetmgr@35001f00 {
		compatible = "brcm,bcm21664-resetmgr";
		reg = <0x35001f00 0x24>;
	};
```

## linux/Documentation/devicetree/bindings/power/reset/gemini-poweroff.txt
```
https://powcoder.com
代写代考加微信 powcoder
Assignment Project Exam Help
Add WeChat powcoder
* Device-Tree bindings for Cortina Systems Gemini Poweroff

This is a special IP block in the Cortina Gemini SoC that only
deals with different ways to power the system down.

Required properties:
- compatible: should be "cortina,gemini-power-controller"
- reg: should contain the physical memory base and size
- interrupts: should contain the power management interrupt

Example:

power-controller@4b000000 {
	compatible = "cortina,gemini-power-controller";
	reg = <0x4b000000 0x100>;
	interrupts = <26 IRQ_TYPE_EDGE_FALLING>;
};
```

## linux/Documentation/devicetree/bindings/power/reset/msm-poweroff.txt
```
https://powcoder.com
代写代考加微信 powcoder
Assignment Project Exam Help
Add WeChat powcoder
MSM Restart Driver

A power supply hold (ps-hold) bit is set to power the msm chipsets.
Clearing that bit allows us to restart/poweroff. The difference
between poweroff and restart is determined by unique power manager IC
settings.

Required Properties:
-compatible: "qcom,pshold"
-reg: Specifies the physical address of the ps-hold register

Example:

	restart@fc4ab000 {
		compatible = "qcom,pshold";
		reg = <0xfc4ab000 0x4>;
	};
```

## linux/Documentation/devicetree/bindings/power/reset/restart-poweroff.txt
```
https://powcoder.com
代写代考加微信 powcoder
Assignment Project Exam Help
Add WeChat powcoder
* Restart Power Off

Buffalo Linkstation LS-XHL and LS-CHLv2, and other devices power off
by restarting and letting u-boot keep hold of the machine until the
user presses a button.

Required Properties:
- compatible: Should be "restart-poweroff"
```

## linux/Documentation/devicetree/bindings/power/reset/st-reset.txt
```
https://powcoder.com
代写代考加微信 powcoder
Assignment Project Exam Help
Add WeChat powcoder
*Device-Tree bindings for ST SW reset functionality

Required properties:
- compatible: should be "stih407-restart".
- st,syscfg: should be a phandle of the syscfg node.

Example node:
	restart {
		compatible = "st,stih407-restart";
		st,syscfg = <&syscfg_sbc_reg>;
	};
```

## linux/Documentation/devicetree/bindings/power/supply/battery.txt
```
https://powcoder.com
代写代考加微信 powcoder
Assignment Project Exam Help
Add WeChat powcoder
The contents of this file has been moved to battery.yaml

Please note that not all charger drivers respect all of the properties.
```

## linux/Documentation/devicetree/bindings/power/supply/olpc_battery.txt
```
https://powcoder.com
代写代考加微信 powcoder
Assignment Project Exam Help
Add WeChat powcoder
OLPC battery
~~~~~~~~~~~~

Required properties:
  - compatible : "olpc,xo1-battery" or "olpc,xo1.5-battery"
```

## linux/Documentation/devicetree/bindings/rng/nuvoton,npcm-rng.txt
```
https://powcoder.com
代写代考加微信 powcoder
Assignment Project Exam Help
Add WeChat powcoder
NPCM SoC Random Number Generator

Required properties:
- compatible  : "nuvoton,npcm750-rng" for the NPCM7XX BMC.
- reg         : Specifies physical base address and size of the registers.

Example:

rng: rng@f000b000 {
	compatible = "nuvoton,npcm750-rng";
	reg = <0xf000b000 0x8>;
};
```

## linux/Documentation/devicetree/bindings/rng/st,rng.txt
```
https://powcoder.com
代写代考加微信 powcoder
Assignment Project Exam Help
Add WeChat powcoder
STMicroelectronics HW Random Number Generator
----------------------------------------------

Required parameters:
compatible	: Should be "st,rng"
reg		: Base address and size of IP's register map.
clocks		: Phandle to device's clock (See: ../clocks/clock-bindings.txt)

Example:

rng@fee80000 {
	compatible      = "st,rng";
	reg		= <0xfee80000 0x1000>;
	clocks          = <&clk_sysin>;
}
```

## linux/Documentation/devicetree/bindings/rtc/cpcap-rtc.txt
```
https://powcoder.com
代写代考加微信 powcoder
Assignment Project Exam Help
Add WeChat powcoder
Motorola CPCAP PMIC RTC
-----------------------

This module is part of the CPCAP. For more details about the whole
chip see Documentation/devicetree/bindings/mfd/motorola-cpcap.txt.

Requires node properties:
- compatible: should contain "motorola,cpcap-rtc"
- interrupts: An interrupt specifier for alarm and 1 Hz irq

Example:

&cpcap {
	cpcap_rtc: rtc {
		compatible = "motorola,cpcap-rtc";
		interrupts = <39 IRQ_TYPE_NONE>, <26 IRQ_TYPE_NONE>;
	};
};
```

## linux/Documentation/devicetree/bindings/rtc/maxim,mcp795.txt
```
https://powcoder.com
代写代考加微信 powcoder
Assignment Project Exam Help
Add WeChat powcoder
* Maxim MCP795		SPI Serial Real-Time Clock

Required properties:
- compatible: Should contain "maxim,mcp795".
- reg: SPI address for chip

Example:
	mcp795: rtc@0 {
		compatible = "maxim,mcp795";
		reg = <0>;
	};
```

## linux/Documentation/devicetree/bindings/rtc/olpc-xo1-rtc.txt
```
https://powcoder.com
代写代考加微信 powcoder
Assignment Project Exam Help
Add WeChat powcoder
OLPC XO-1 RTC
~~~~~~~~~~~~~

Required properties:
 - compatible : "olpc,xo1-rtc"
```

## linux/Documentation/devicetree/bindings/rtc/pcf85363.txt
```
https://powcoder.com
代写代考加微信 powcoder
Assignment Project Exam Help
Add WeChat powcoder
NXP PCF85263/PCF85363 Real Time Clock
============================

Required properties:
- compatible: Should contain "nxp,pcf85263" or "nxp,pcf85363".
- reg: I2C address for chip.

Optional properties:
- interrupts: IRQ line for the RTC (not implemented).

Example:

pcf85363: pcf85363@51 {
	compatible = "nxp,pcf85363";
	reg = <0x51>;
};
```

## linux/Documentation/devicetree/bindings/rtc/sirf,prima2-sysrtc.txt
```
https://powcoder.com
代写代考加微信 powcoder
Assignment Project Exam Help
Add WeChat powcoder
SiRFSoC Real Time Clock

Required properties:
- compatible: must be "sirf,prima2-sysrtc"
- reg: address range of rtc register set.
- interrupts: rtc alarm interrupts.

Example:
	rtc@2000 {
		compatible = "sirf,prima2-sysrtc";
		reg = <0x2000 0x1000>;
		interrupts = <52 53 54>;
	};
```

## linux/Documentation/devicetree/bindings/rtc/twl-rtc.txt
```
https://powcoder.com
代写代考加微信 powcoder
Assignment Project Exam Help
Add WeChat powcoder
* Texas Instruments TWL4030/6030 RTC

Required properties:
- compatible : Should be "ti,twl4030-rtc"
- interrupts : Should be the interrupt number.

Example:
	rtc {
		compatible = "ti,twl4030-rtc";
		interrupts = <11>;
	};
```

## linux/Documentation/devicetree/bindings/rtc/via,vt8500-rtc.txt
```
https://powcoder.com
代写代考加微信 powcoder
Assignment Project Exam Help
Add WeChat powcoder
VIA/Wondermedia VT8500 Realtime Clock Controller
-----------------------------------------------------

Required properties:
- compatible : "via,vt8500-rtc"
- reg : Should contain 1 register ranges(address and length)
- interrupts : alarm interrupt

Example:

	rtc@d8100000 {
		compatible = "via,vt8500-rtc";
		reg = <0xd8100000 0x10000>;
		interrupts = <48>;
	};
```

## linux/Documentation/devicetree/bindings/serial/altera_jtaguart.txt
```
https://powcoder.com
代写代考加微信 powcoder
Assignment Project Exam Help
Add WeChat powcoder
Altera JTAG UART

Required properties:
- compatible : should be "ALTR,juart-1.0" <DEPRECATED>
- compatible : should be "altr,juart-1.0"
```
